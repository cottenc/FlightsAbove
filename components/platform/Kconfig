## components/platform/Kconfig
```kconfig
menu "FlightsAbove platform"

choice FLIGHTSABOVE_PLATFORM
    prompt "Hardware platform"
    default FLIGHTSABOVE_PLATFORM_SENSECAP
    help
        Select the hardware adapter used by the UI runtime. SenseCAP remains
        the tested default path.

config FLIGHTSABOVE_PLATFORM_SENSECAP
    bool "SenseCAP Indicator D1Pro"
    help
        Seeed SenseCAP Indicator D1Pro with the current RGB framebuffer and
        FT5x06 touch path.

config FLIGHTSABOVE_PLATFORM_LILYGO_T_DISPLAY_S3
    bool "LilyGo T-Display-S3 (reserved)"
    help
        Reserved target for the compact-wide LilyGo T-Display-S3 family.
        Selecting this target intentionally fails until the display, touch,
        backlight, and flush adapter are implemented.

config FLIGHTSABOVE_PLATFORM_ROUND_360
    bool "Generic round ESP32-S3 360x360 (reserved)"
    help
        Reserved target for the planned round display class. Selecting this
        target intentionally fails until the exact board/controller is
        confirmed and a real platform adapter is implemented.

endchoice

endmenu
```

## components/seeed_indicator/Kconfig
```kconfig
menu "Seeed Indicator Bus Options"

    config I2C_BUS_DYNAMIC_CONFIG
        bool "Enable dynamic I2C configuration"
        default y

    config I2C_MS_TO_WAIT
        int "I2C mutex block time (ms)"
        default 200
        range 50 5000

endmenu
```

## sdkconfig.defaults
```kconfig
# SenseCAP Indicator D1Pro - ESP32-S3 + 8 MB flash + PSRAM
CONFIG_IDF_TARGET="esp32s3"

# Flash
CONFIG_ESPTOOLPY_FLASHSIZE_8MB=y
CONFIG_PARTITION_TABLE_CUSTOM=y
CONFIG_PARTITION_TABLE_CUSTOM_FILENAME="partitions.csv"

# PSRAM
CONFIG_SPIRAM=y
CONFIG_SPIRAM_MODE_OCT=y
CONFIG_SPIRAM_USE_MALLOC=y
CONFIG_SPIRAM_TYPE_AUTO=y
CONFIG_SPIRAM_SPEED_80M=y
CONFIG_SPIRAM_FETCH_INSTRUCTIONS=y
CONFIG_SPIRAM_RODATA=y

# FreeRTOS
CONFIG_FREERTOS_HZ=1000
CONFIG_ESP_MAIN_TASK_STACK_SIZE=8192

# Logging
CONFIG_LOG_DEFAULT_LEVEL_INFO=y

# TLS clients need enough contiguous memory for HTTPS image downloads. Allocate
# mbedTLS buffers from PSRAM and free them between record reads/writes.
CONFIG_MBEDTLS_EXTERNAL_MEM_ALLOC=y
CONFIG_MBEDTLS_ASYMMETRIC_CONTENT_LEN=y
CONFIG_MBEDTLS_SSL_IN_CONTENT_LEN=16384
CONFIG_MBEDTLS_SSL_OUT_CONTENT_LEN=4096
CONFIG_MBEDTLS_DYNAMIC_BUFFER=y
CONFIG_MBEDTLS_CERTIFICATE_BUNDLE=y
CONFIG_MBEDTLS_CERTIFICATE_BUNDLE_DEFAULT_FULL=y
CONFIG_MBEDTLS_CERTIFICATE_BUNDLE_CROSS_SIGNED_VERIFY=y
CONFIG_MBEDTLS_X509_TRUSTED_CERT_CALLBACK=y

# LVGL
CONFIG_LV_FONT_MONTSERRAT_14=y
CONFIG_LV_FONT_MONTSERRAT_20=y
CONFIG_LV_FONT_MONTSERRAT_28=y
CONFIG_LV_FONT_MONTSERRAT_48=y
CONFIG_LV_MEM_SIZE_KILOBYTES=64
CONFIG_LV_IMG_CACHE_DEF_SIZE=1
CONFIG_LV_USE_PNG=y

# RGB LCD scanout
CONFIG_LCD_RGB_ISR_IRAM_SAFE=y

# SenseCAP Indicator board + screen variant
CONFIG_FLIGHTSABOVE_PLATFORM_SENSECAP=y
CONFIG_LCD_BOARD_SENSECAP_INDICATOR_D1=y
CONFIG_SENSECAP_INDICATOR_SCREEN_GX=y
CONFIG_LCD_EVB_SCREEN_ROTATION_0=y
CONFIG_LCD_EVB_SCREEN_FREQ=16
CONFIG_LCD_AVOID_TEAR=y
CONFIG_LCD_LVGL_DIRECT_MODE=y
```
